## orange_pi_zero_3.its
```
/dts-v1/;

/ {
    description = "OrangePi Zero 3";
    #address-cells = <1>;

    images {
        kernel-1 {
            data = /incbin/("Image.gz");
            type = "kernel";
            arch = "arm64";
            os = "linux";
            compression = "gzip";
            load = <0x40000000>;
            entry = <0x40080000>;

            hash-1 {
                algo = "sha1";
            };
         };

        fdt-1 {
            description = "sun50i-h616-orangepi-zero3.dtb";
            data = /incbin/("sun50i-h616-orangepi-zero3.dtb");
            type = "flat_dt";
            arch = "arm64";
            compression = "none";

            hash-1 {
                algo = "sha1";
            };
        };
    };

    configurations {
        default = "conf-1";
        conf-1 {
            kernel = "kernel-1";
            fdt = "fdt-1";
        };
    };
};
```

## uboot/uboot_defconfig
```kconfig
CONFIG_ARM=y
CONFIG_ARCH_SUNXI=y
CONFIG_DEFAULT_DEVICE_TREE="sun50i-h616-orangepi-zero3"
CONFIG_SPL=y
CONFIG_DRAM_SUN50I_H616_READ_CALIBRATION=y
CONFIG_DRAM_SUN50I_H616_BIT_DELAY_COMPENSATION=y
CONFIG_DRAM_SUN50I_H616_UNKNOWN_FEATURE=y
CONFIG_DRAM_SUN50I_H616_TRIM_SIZE=y
CONFIG_SUNXI_DRAM_H616_LPDDR4=y
CONFIG_MACH_SUN50I_H616=y
CONFIG_DRAM_CLK=792
CONFIG_PWRLED="PC12"
CONFIG_MMC0_CD_PIN="PF6"
CONFIG_R_I2C_ENABLE=y
CONFIG_SPL_SPI_SUNXI=y
CONFIG_PREBOOT=""
CONFIG_SPL_I2C=y
# CONFIG_ENV_IS_IN_FAT is not set
CONFIG_ENV_IS_IN_MMC=y
# CONFIG_ENV_IS_IN_SPI_FLASH is not set
CONFIG_SPL_SYS_I2C_LEGACY=y
CONFIG_SYS_I2C_MVTWSI=y
CONFIG_SYS_I2C_SLAVE=0x7f
CONFIG_SYS_I2C_SPEED=400000
CONFIG_SPI_FLASH_MACRONIX=y
CONFIG_PHY_REALTEK=y
CONFIG_SUN8I_EMAC=y
CONFIG_AXP313A_POWER=y
CONFIG_SPI=y
CONFIG_USB_EHCI_HCD=y
CONFIG_USB_OHCI_HCD=y
CONFIG_USB_MUSB_GADGET=y
CONFIG_EFI_VARIABLE_NO_STORE=y
```
